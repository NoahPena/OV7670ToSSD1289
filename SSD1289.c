#include "lm3s1968.h"
#include "Main.h"
#include <math.h>
#include <string.h>
/**
*
* 	SSD 1289 Driver File
*
*		Pin Defintions:
*		RD = Read(Active Low)
*		WR = Write(Active Low)
*		CS = Chip Select(Active Low)
*		RS = High = Data; Low = Command
*		RST = Low = Enable
*		DP_Lo = Data Bus {0 - 7}
*		DP_Hi = Data Bus {8 - 15}
*
*		LCD Screen Pinout:
*		RD = PD0
*		WR = PD1
*		CS = PD2
*		RS = PD3
*		RST = PG5
*		DB0-DB7 = PA0 - PA7
*		DB8-DB15 = PF0 - PF7
*/

void LCD_Init(void);
void Write_Command(unsigned int);
void Write_Data(unsigned int);
void Write_Command_Data(unsigned int, unsigned int);
unsigned int Set_color(unsigned int, unsigned int, unsigned int);
void TFT_Fill(unsigned int);
void TFT_Box(unsigned int,unsigned int,unsigned int,unsigned int,unsigned int);
void TFT_Dot(unsigned int, unsigned int, unsigned int);
void TFT_Line(unsigned int, unsigned int, unsigned int, unsigned int, unsigned int);
void TFT_H_Line(char, char, unsigned int, unsigned int);
void TFT_V_Line(unsigned int, unsigned int, char, unsigned int);
void TFT_Rectangle(unsigned int, unsigned int, unsigned int, unsigned int, unsigned int);
void TFT_Circle(unsigned int, unsigned int, char, char, unsigned int);
void TFT_Char(char, unsigned int, unsigned int, char, unsigned int, unsigned int);
void TFT_Text(char*,unsigned int,unsigned int,char,unsigned int,unsigned int);
void TFT_Image(unsigned int,unsigned int,unsigned int,unsigned int,const unsigned int*);

const char Font_8x8[784] = {
0x00,0x00,0x00,0x00,0x00,0x00,0x00,0x00, // space 0x20
0x30,0x78,0x78,0x30,0x30,0x00,0x30,0x00, // !
0x6C,0x6C,0x6C,0x00,0x00,0x00,0x00,0x00, // "
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0x22,0x77,0x7f,0x7f,0x3e,0x1c,0x08,0x00         //HEART use:�
};

const char Font_16x16[3040]  = {
0x00,0x00,0x00,0x00,0x00,0x00,0x00,0x00,0x00,0x00,0x00,0x00,0x00,0x00,0x00,0x00,0x00,0x00,0x00,0x00,0x00,0x00,0x00,0x00,0x00,0x00,0x00,0x00,0x00,0x00,0x00,0x00, //  <Space>
0x00,0x00,0x00,0x00,0x07,0x00,0x0F,0x80,0x0F,0x80,0x0F,0x80,0x0F,0x80,0x0F,0x80,0x07,0x00,0x07,0x00,0x00,0x00,0x00,0x00,0x07,0x00,0x07,0x00,0x07,0x00,0x00,0x00, // !
0x00,0x00,0x0E,0x38,0x0E,0x38,0x0E,0x38,0x0E,0x38,0x06,0x30,0x00,0x00,0x00,0x00,0x00,0x00,0x00,0x00,0x00,0x00,0x00,0x00,0x00,0x00,0x00,0x00,0x00,0x00,0x00,0x00, // "
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0x00,0x00,0x00,0x00,0x1F,0x1C,0x3B,0x9C,0x39,0xDC,0x38,0xF8,0x00,0x00,0x00,0x00,0x00,0x00,0x00,0x00,0x00,0x00,0x00,0x00,0x00,0x00,0x00,0x00,0x00,0x00,0x00,0x00  // ~
};

void LCD_Init()
{
	GPIO_PORTD_DATA_R |= 0x01;											//RD = 1
	GPIO_PORTG_DATA_R |= 0x20;											//RST = 1
	ghettoDelay(7);
	GPIO_PORTG_DATA_R &= 0xDF;											//RST = 0
	ghettoDelay(17);
	GPIO_PORTG_DATA_R |= 0x20;											//RST = 1
	ghettoDelay(17);
	GPIO_PORTD_DATA_R &= 0x0B;											//CS = 0
	
	Write_Command_Data(0x00,0x0001);
	Write_Command_Data(0x03,0xA8A4);
	Write_Command_Data(0x0C,0x0000);
	Write_Command_Data(0x0D,0x080C);
	Write_Command_Data(0x0E,0x2B00);
	Write_Command_Data(0x1E,0x00B7);
	Write_Command_Data(0x01,0x2B3F);
	Write_Command_Data(0x02,0x0600);
	Write_Command_Data(0x10,0x0000);
	Write_Command_Data(0x11,0x6070);
	Write_Command_Data(0x05,0x0000);
	Write_Command_Data(0x06,0x0000);
	Write_Command_Data(0x16,0xEF1C);
	Write_Command_Data(0x17,0x0003);
	Write_Command_Data(0x07,0x0233);
	Write_Command_Data(0x0B,0x0000);
	Write_Command_Data(0x0F,0x0000);
	Write_Command_Data(0x41,0x0000);
	Write_Command_Data(0x42,0x0000);
	Write_Command_Data(0x48,0x0000);
	Write_Command_Data(0x49,0x013F);
	Write_Command_Data(0x4A,0x0000);
	Write_Command_Data(0x4B,0x0000);
	Write_Command_Data(0x44,0xEF00);
	Write_Command_Data(0x45,0x0000);
	Write_Command_Data(0x46,0x013F);
	Write_Command_Data(0x30,0x0707);
	Write_Command_Data(0x31,0x0204);
	Write_Command_Data(0x32,0x0204);
	Write_Command_Data(0x33,0x0502);
	Write_Command_Data(0x34,0x0507);
	Write_Command_Data(0x35,0x0204);
	Write_Command_Data(0x36,0x0204);
	Write_Command_Data(0x37,0x0502);
	Write_Command_Data(0x3A,0x0302);
	Write_Command_Data(0x3B,0x0302);
	Write_Command_Data(0x23,0x0000);
	Write_Command_Data(0x24,0x0000);
	Write_Command_Data(0x25,0x8000);
	Write_Command_Data(0x4f,0x0000);
	Write_Command_Data(0x4e,0x0000);
	Write_Command(0x22);
	
	GPIO_PORTD_DATA_R |= 0x04;
}

void Write_Command(unsigned int Wcommand)
{
  GPIO_PORTD_DATA_R |= 0x01;											//RD = 1
	GPIO_PORTD_DATA_R &= 0x07;											//RS = 0;
	GPIO_PORTF_DATA_R = Wcommand >> 8;							//PB 8-15 to command
  GPIO_PORTA_DATA_R = Wcommand ;									//PB 0-7 to command
  GPIO_PORTD_DATA_R	&= 0x0D;											//WR = 0
	GPIO_PORTD_DATA_R |= 0x02;											//WR = 1
}

void Write_Data(unsigned int Wdata)
{
	GPIO_PORTD_DATA_R |= 0x01;											//RD = 1
	GPIO_PORTD_DATA_R |= 0x08;											//RS = 1
  GPIO_PORTF_DATA_R = Wdata >>8 ;
  GPIO_PORTA_DATA_R = Wdata;
  GPIO_PORTD_DATA_R	&= 0x0D;											//WR = 0
	GPIO_PORTD_DATA_R |= 0x02;											//WR = 1  
}

void Write_Command_Data(unsigned int Wcommand,unsigned int Wdata)
{
   Write_Command(Wcommand);
   Write_Data(Wdata);
}

void TFT_Set_Address(unsigned int PX1,unsigned int PY1,unsigned int PX2,unsigned int PY2)
{
  Write_Command_Data(68,(PX2 << 8) + PX1 );  //Column address start2
  Write_Command_Data(69,PY1);      //Column address start1
  Write_Command_Data(70,PY2);  //Column address end2
  Write_Command_Data(78,PX1);      //Column address end1
  Write_Command_Data(79,PY1);  //Row address start2
  Write_Command(34);
}

unsigned int Set_color(unsigned int r,unsigned int g,unsigned int b)
{
  unsigned int temp;
  temp = (r & 0xF8) | (g >> 5);
              g = (g & 0x1C);
  temp = (g << 3) | (b >>3);
  return temp;
}

void TFT_Fill(unsigned int color)
{
  unsigned int i,j;
  GPIO_PORTD_DATA_R &= 0x0B;
  TFT_Set_Address(0,0,239,319);
  Write_Data(color);
  for(i = 0; i <= 319; i++)
  {
    for(j = 0; j <= 239; j++)
    {
        GPIO_PORTD_DATA_R &= 0x0D;
        GPIO_PORTD_DATA_R |= 0x02;
    }
  }
  GPIO_PORTD_DATA_R |= 0x04;
}


void TFT_Box(unsigned int x1,unsigned int y1,unsigned int x2,unsigned int y2,unsigned int color)
{
  unsigned int  i,j;
  GPIO_PORTD_DATA_R &= 0x0B;
  TFT_Set_Address(x1,y1,x2,y2);
  Write_Data(color);
  for(i = y1; i <= y2; i++)
  {
    for(j = x1; j <= x2; j++)
    {
        GPIO_PORTD_DATA_R &= 0x0D;
        GPIO_PORTD_DATA_R |= 0x02;
    }
  }
  GPIO_PORTD_DATA_R |= 0x04;
}


void TFT_Dot(unsigned int x,unsigned int y,unsigned int color)
{
  GPIO_PORTD_DATA_R &= 0x0B;
  TFT_Set_Address(x,y,x,y);
  Write_Data(color);
  GPIO_PORTD_DATA_R |= 0x04;
}

void TFT_Line(unsigned int x1,unsigned int y1,unsigned int x2,unsigned int y2,unsigned int color)
{
int x,y,addx,addy,dx,dy;
long P;
unsigned int i;

  dx = fabs(x2-x1);
  dy = fabs(y2-y1);
  x = x1;
  y = y1;

   if(x1 > x2)
   {
       addx = -1;
   }
   else
   {
       addx = 1;
   }

   if(y1 > y2)
   {
      addy = -1;
   }
   else
   {
      addy = 1;
   }


 if(dx >= dy)
 {

  P = (2*dy) - dx;

   for(i = 1; i <= (dx +1); i++)
   {

     TFT_Dot(x,y,color);

     if(P < 0)
     {
         P = P + (2*dy);
         x = (x + addx);
     }
     else
     {
        P = P+(2*dy) - (2*dx);
        x = x + addx;
        y = y + addy;
     }
    }
  }
  else
  {
    P = (2*dx) - dy;

    for(i = 1; i <= (dy +1); i++)
    {

     TFT_Dot(x,y,color);

     if(P<0)
     {
       P = P + (2*dx);
       y = y + addy;
     }
     else
     {
        P = P + (2*dx) - (2*dy);
        x = x + addx;
        y = y + addy;
     }
    }
   }
}

void TFT_H_Line(char x1,char x2,unsigned int y_pos,unsigned int color)
{
  TFT_Box(x1,y_pos,x2,y_pos+1,color);
}

void TFT_V_Line(unsigned int y1,unsigned int y2,char x_pos,unsigned int color)
{
  TFT_Box(x_pos,y1,x_pos+1,y2,color);
}

void TFT_Rectangle(unsigned int x1,unsigned int y1,unsigned int x2,unsigned int y2,unsigned int color)
{
  TFT_H_Line(x1,x2,y1,color);
  TFT_H_Line(x1,x2,y2,color);
  TFT_V_Line(y1,y2,x1,color);
  TFT_V_Line(y1,y2,x2,color);
}

void TFT_Circle(unsigned int x,unsigned int y,char radius,char fill,unsigned int color)
{
int a_,b_,P;
 a_ = 0;
 b_ = radius;
 P = 1 - radius;
 while (a_ <= b_)
 {
    if(fill == 1)
    {
         TFT_Box(x-a_,y-b_,x+a_,y+b_,color);
         TFT_Box(x-b_,y-a_,x+b_,y+a_,color);
    }
    else
    {
         TFT_Dot(a_+x, b_+y, color);
         TFT_Dot(b_+x, a_+y, color);
         TFT_Dot(x-a_, b_+y, color);
         TFT_Dot(x-b_, a_+y, color);
         TFT_Dot(b_+x, y-a_, color);
         TFT_Dot(a_+x, y-b_, color);
         TFT_Dot(x-a_, y-b_, color);
         TFT_Dot(x-b_, y-a_, color);
    }
    if (P < 0 )
    {
        P = (P + 3) + (2* a_);
        a_ ++;
    }
    else
    {
        P = (P + 5) + (2* (a_ - b_));
        a_ ++;
        b_ --;
    }
  }
}

void TFT_Char(char C,unsigned int x,unsigned int y,char DimFont,unsigned int Fcolor,unsigned int Bcolor)
{
const char *PtrFont;
unsigned int Cptrfont;
unsigned int font8x8[8];
unsigned int font16x16[16];
char k,i,print1,print2;
unsigned int print3,print4;

if(DimFont == 8)
{
     PtrFont = &Font_8x8[0];
     Cptrfont = (C-32)*8;
     PtrFont = PtrFont + Cptrfont;

     for(k = 0; k <= 7; k++)
     {
      font8x8[k] = *PtrFont;
      PtrFont++;
     }
     
     GPIO_PORTD_DATA_R &= 0x0B;
     TFT_Set_Address(x,y,x+7,y+7);
     for(i = 0; i <= 7; i++)
     {
       for(k = 0; k <= 7; k++)
       {
          print1 = (font8x8[i] & 0x80);
          print2 = print1 >>7;
          if(print2 == 1)
          {
             Write_Data(Fcolor);
          }
          else
          {
             Write_Data(Bcolor);
          }
          font8x8[i] = font8x8[i] << 1;
       }
     }
     GPIO_PORTD_DATA_R |= 0x04;
}

else if(DimFont == 16)
{
     PtrFont = &Font_16x16[0];
     Cptrfont = (C-32)*32;
     PtrFont = PtrFont + Cptrfont;

     for(k = 0; k <= 15; k++)
     {
      font16x16[k] = *PtrFont;
      PtrFont++;
      font16x16[k] = (font16x16[k] << 8);
      font16x16[k] = font16x16[k] + *PtrFont;
      PtrFont++;
     }

     GPIO_PORTD_DATA_R &= 0x0B;
     TFT_Set_Address(x,y,x+15,y+15);
     for(i = 0; i <= 15; i++)
     {
       for(k = 0; k <= 15; k++)
       {
        print3 = (font16x16[i] & 0x8000);
        print4 = print3 >>15;

        if(print4 == 1)
        {
           Write_Data(Fcolor);
        }
        else
        {
           Write_Data(Bcolor);
        }

        font16x16[i] = font16x16[i] << 1;
       }
     }
     GPIO_PORTD_DATA_R |= 0x04;
}
}

void TFT_Text(char* S,unsigned int x,unsigned int y,char DimFont,unsigned int Fcolor,unsigned int Bcolor)
{
  int length,cnt;
  char buffer[24];
  length = strlen(S);

  for(cnt = 0; cnt <= (length - 1); cnt++)
  {
    buffer[cnt] = S[cnt];
  }

  if(DimFont == 8)
  {
      for(cnt = 0; cnt <= (length - 1); cnt++)
      {
        TFT_Char(buffer[cnt],x,y,DimFont,Fcolor,Bcolor);
        x = x + 8;
      }
  }
  else if(DimFont == 16)
  {
      for(cnt = 0; cnt <= (length - 1); cnt++)
      {
        TFT_Char(buffer[cnt],x,y,DimFont,Fcolor,Bcolor);
        x = x + 16;
      }
  }
}

void TFT_Image(unsigned int pos_x,unsigned int pos_y,unsigned int dim_x,unsigned int dim_y,const unsigned int *picture){
    unsigned int x, y;

    GPIO_PORTD_DATA_R &= 0x0B;
    TFT_Set_Address(pos_x, pos_y, pos_x + dim_x - 1, pos_y + dim_y - 1);
    for(y = pos_y; y < (pos_y + dim_y); y++ ) {
        for(x = pos_x; x < (pos_x + dim_x); x++ ) {
            Write_Data(*picture++);
        }
    }
    GPIO_PORTD_DATA_R |= 0x04;
}
